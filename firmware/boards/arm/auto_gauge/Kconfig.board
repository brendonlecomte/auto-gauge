## firmware/boards/arm/auto_gauge/Kconfig.board
```kconfig
# AutoGauge board configuration

# copyright?.
# license!

config BOARD_AUTO_GAUGE
	bool "Auto Gauge"
	depends on SOC_PART_NUMBER_SAMD21E18A
```

## firmware/boards/arm/auto_gauge/Kconfig.defconfig
```kconfig
# AutoGauge Board configuration

# copyright?
# license!

config BOARD
	default "auto_gauge"
	depends on BOARD_AUTO_GAUGE
```

## firmware/boards/arm/auto_gauge/auto_gauge_defconfig
```kconfig
# ...

CONFIG_SOC_SERIES_SAMD21=y
CONFIG_SOC_PART_NUMBER_SAMD21E18A=y
CONFIG_BOARD_AUTO_GAUGE=y
CONFIG_SOC_ATMEL_SAMD_OSC8M_AS_MAIN=y
CONFIG_CORTEX_M_SYSTICK=y
CONFIG_GPIO=y
CONFIG_PINMUX=y
CONFIG_USE_DT_CODE_PARTITION=y

CONFIG_SERIAL=y
CONFIG_UART_INTERRUPT_DRIVEN=y

CONFIG_USB=y
CONFIG_USB_DC_SAM0=y
CONFIG_USB_DEVICE_STACK=y
CONFIG_USB_DEVICE_PRODUCT="AutoGauge"
CONFIG_USB_CDC_ACM=y

#temp till boards are back
CONFIG_BOOTLOADER_BOSSA=y
CONFIG_BOOTLOADER_BOSSA_ADAFRUIT_UF2=y
```
